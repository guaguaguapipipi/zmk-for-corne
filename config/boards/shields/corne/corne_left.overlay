/*
 * Copyright (c) 2020 Pete Johanson
 *
 * SPDX-License-Identifier: MIT
 */

#include "corne.dtsi"

&kscan0 {
    col-gpios
        = <&pro_micro 21 GPIO_ACTIVE_HIGH>
        , <&pro_micro 20 GPIO_ACTIVE_HIGH>
        , <&pro_micro 19 GPIO_ACTIVE_HIGH>
        , <&pro_micro 18 GPIO_ACTIVE_HIGH>
        , <&pro_micro 15 GPIO_ACTIVE_HIGH>
        , <&pro_micro 14 GPIO_ACTIVE_HIGH>
        ;
};

&spi1 {
    cs-gpios = <&gpio0 14 (GPIO_ACTIVE_HIGH | GPIO_PULL_DOWN)>;
    status = "okay";
    lcd0: lcd@0 {
        compatible ="jdi,lpm009m360a";
        reg =<0>;
        status = "okay";
        spi-max-frequency = <4000000>;
        disp_gpios = <&gpio0 3 GPIO_ACTIVE_HIGH>;
        extcomin_gpios = <&gpio0 28 GPIO_ACTIVE_HIGH>;
        width = <144>;
        height = <72>;
        color mode = [02];
        reverse = <1>;
        rotation = <1>;
    };
};
